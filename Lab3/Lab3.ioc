# file: Lab3.ioc
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Mcu.Family=STM32F0
Mcu.Name=STM32F072R(8-B)Tx
Mcu.Package=LQFP64
ProjectManager.HeapSize=0x200
ProjectManager.StackSize=0x400
ProjectManager.TargetToolchain=MDK-ARM V5.32
board=custom

// file: Core/Src/main.c
/* USER CODE BEGIN Header */
/**
  ******************************************************************************
  * @file           : main.c
  * @brief          : Main program body
  ******************************************************************************
  * @attention
  *
  * Copyright (c) 2024 STMicroelectronics.
  * All rights reserved.
  *
  * This software is licensed under terms that can be found in the LICENSE file
  * in the root directory of this software component.
  * If no LICENSE file comes with this software, it is provided AS-IS.
  *
  ******************************************************************************
  */
/* USER CODE END Header */
#include "main.h"

void SystemClock_Config(void);
/* USER CODE BEGIN PFP */

void TIM2_IRQHandler(void){
	GPIOC->ODR ^= (1 << 8);
	GPIOC->ODR ^= (1 << 9);
	TIM2->SR &= ~(1<<0);
}

/* USER CODE END PFP */

int main(void)
{

  HAL_Init();

  SystemClock_Config();
	RCC->AHBENR |= RCC_AHBENR_GPIOCEN; // Enabling the GPIOC Timer
	RCC->APB1ENR |= RCC_APB1ENR_TIM2EN;
	RCC->APB1ENR |= RCC_APB1ENR_TIM3EN;
	TIM2->PSC = 7999;
	TIM2->ARR = 250;
	TIM3->PSC = 999;
	TIM3->ARR = 10;

	TIM3->CCMR1 &= ~((1<<0)|(1<<1)|(1<<9)|(1<<8)|(1<<12));
	TIM3->CCMR1 |= ((1<<4)|(1<<5)|(1<<6)|(1<<13)|(1<<14)|(1<<3)|(1<<11));
	TIM3->CCER |= ((1<<0)|(1<<4));
	TIM2->DIER |= (1 << 0);

	TIM3->CCR1 = 1;
	TIM3->CCR2 = 1;

	NVIC_SetPriority(TIM2_IRQn, 1);
	NVIC_EnableIRQ( TIM2_IRQn );

	GPIOC->MODER |= ((1 << 13)|(1 << 15) | (1 << 16) | (1 << 18));
	GPIOC->MODER &= ~((1 << 12)|(1 << 14) | (1 << 17) | (1 << 19));

	GPIOC->OTYPER &= ~((1 << 6)|(1 << 7) | (1 << 8) | (1 << 9));

	GPIOC->OSPEEDR &= ~((1 << 12)|(1 << 14)|(1 << 16)|(1 << 18 ));

	GPIOC->PUPDR &= ~((1 << 13)|(1 << 15)|(1 << 12)|(1 << 14)|(1 << 16) | (1 << 18)|(1 << 17) | (1 << 19));

	GPIOC->AFR[0] &= ~(GPIO_AFRL_AFSEL6|GPIO_AFRL_AFSEL7);

	GPIOC->ODR |= (1 << 8);
	TIM2->EGR |= (1<<0);
	TIM3->CR1 |= (1<<0);
	TIM2->CR1 |= (1<<0);
  while (1)
  {

  }
  /* USER CODE END 3 */
}

void SystemClock_Config(void)
{
  RCC_OscInitTypeDef RCC_OscInitStruct = {0};
  RCC_ClkInitTypeDef RCC_ClkInitStruct = {0};

  /** Initializes the RCC Oscillators according to the specified parameters
  * in the RCC_OscInitTypeDef structure.
  */
  RCC_OscInitStruct.OscillatorType = RCC_OSCILLATORTYPE_HSI;
  RCC_OscInitStruct.HSIState = RCC_HSI_ON;
  RCC_OscInitStruct.HSICalibrationValue = RCC_HSICALIBRATION_DEFAULT;
  RCC_OscInitStruct.PLL.PLLState = RCC_PLL_NONE;
  if (HAL_RCC_OscConfig(&RCC_OscInitStruct) != HAL_OK)
  {
    Error_Handler();
  }

  /** Initializes the CPU, AHB and APB buses clocks
  */
  RCC_ClkInitStruct.ClockType = RCC_CLOCKTYPE_HCLK|RCC_CLOCKTYPE_SYSCLK
                              |RCC_CLOCKTYPE_PCLK1;
  RCC_ClkInitStruct.SYSCLKSource = RCC_SYSCLKSOURCE_HSI;
  RCC_ClkInitStruct.AHBCLKDivider = RCC_SYSCLK_DIV1;
  RCC_ClkInitStruct.APB1CLKDivider = RCC_HCLK_DIV1;

  if (HAL_RCC_ClockConfig(&RCC_ClkInitStruct, FLASH_LATENCY_0) != HAL_OK)
  {
    Error_Handler();
  }
}

void Error_Handler(void)
{
  __disable_irq();
  while (1)
  {
  }
}
